## conf/distro/phyhub.conf
```bitbake
require conf/distro/ampliphy-vendor-rauc.conf

DISTRO = "phyhub"
DISTRO_NAME = "ampliPHY Vendor phyHUB (Phytec Vendor Distribution + RAUC + phyHUB)"
```

## conf/layer.conf
```bitbake
# SPDX-License-Identifier: MIT

BBPATH .= ":${LAYERDIR}"

BBFILES += "${LAYERDIR}/recipes-*/*/*.bb \
            ${LAYERDIR}/recipes-*/*/*.bbappend"

BBFILE_COLLECTIONS += "phyhub"
BBFILE_PATTERN_phyhub = "^${LAYERDIR}/"
BBFILE_PRIORITY_phyhub = "20"

LAYERDEPENDS_phyhub = "core snapd ampliphy phytec lts-go-mixin"
LAYERSERIES_COMPAT_phyhub = "scarthgap"

require conf/distro/include/common-cyclonedx.inc

INHERIT:remove = "create-spdx"
INHERIT += "create-spdx-3.0"
SPDX_INCLUDE_COMPILED_SOURCES:pn-${PREFERRED_PROVIDER_virtual/kernel} = "1"

BBMASK:append:imx-nxp-bsp = " meta-imx/meta-imx-bsp/recipes-bsp/firmware-imx/firmware-nxp-wifi_%.bbappend"

# WORKAROUND: Override the DISTRO_VERSION, as this is set by other overrides in
# meta-ampliphy
DISTROOVERRIDES .= ":phyhub"
DISTRO_VERSION:phyhub = "2026-10-02"
RAUC_BUNDLE_VERSION = "${DISTRO_VERSION}"
```
